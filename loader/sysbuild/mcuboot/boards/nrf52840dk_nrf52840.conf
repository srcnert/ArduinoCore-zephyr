## modules/rak_zephyr_ble/Kconfig
```kconfig
# Copyright (c) 2026 RAKwireless Technology Limited
# Author: sercan.erat@rakwireless.com
# SPDX-License-Identifier: Apache-2.0

config RAK_ZEPHYR_BLE
	bool "Zephyr Bluetooth host API for sketches"
	depends on BT_CONN
	select BT_GATT_DYNAMIC_DB
	select BT_DEVICE_NAME_DYNAMIC
	help
	  Export the Zephyr Bluetooth host functions a peripheral sketch
	  uses.
```

## test/integration/serial/testcase.yaml
```yaml
# Copyright (c) 2026 RAKwireless Technology Limited
# Author: sercan.erat@rakwireless.com
# SPDX-License-Identifier: Apache-2.0

tests:
  rak.integration.serial:
    platform_allow: rak4631/nrf52840
    harness: pytest
    harness_config:
      pytest_dut_scope: module
```

## west.yml
```yaml
# Copyright (c) 2022 Dhruva Gole <goledhruva@gmail.com>
# SPDX-License-Identifier: Apache-2.0

# NOTE: This is created to be used for CI/CD workflow. So use it only
# if you are in the zephyrproject directory or else things may break.

manifest:
  self:
    path: modules/lib/ArduinoCore-zephyr
    west-commands: extra/rak/west-commands.yml

  remotes:
    - name: zephyrproject-rtos
      url-base: https://github.com/zephyrproject-rtos
    - name: arduino
      url-base: https://github.com/arduino
    - name: facchinm
      url-base: https://github.com/facchinm
    - name: pillo79
      url-base: https://github.com/pillo79
    - name: RAKwireless
      url-base: https://github.com/RAKWireless

  projects:
    - name: zephyr
      remote: arduino
      revision: zephyr-arduino-v4.5.0
      import:
        name-allowlist:
          - cmsis
          - cmsis_6
          - littlefs
          - tinycrypt
          - mbedtls
          - tf-psa-crypto
          - segger
          - thrift
          - mcuboot
          - nanopb
          - lvgl
          - fatfs
          - loramac-node
          - zcbor
        path-allowlist:
          - modules/hal/*

        # The actual list of enabled HALs is set by extra/bootstrap.sh via
        # the 'manifest.project-filter' config. Enable all Zephyr HALs with:
        #
        #   west config -d manifest.project-filter

    - name: cannectivity
      path: modules/lib/cannectivity
      url: https://github.com/CANnectivity/cannectivity.git
      revision: main

    - name: rzi
      remote: RAKwireless
      revision: arduino/zephyr-v4.5.0
      path: modules/lib/rzi
      import:
        name-allowlist:
          - usp
          - usp_zephyr
          - lora-basics-modem

    - name: cpputest
      path: modules/lib/cpputest
      url: https://github.com/cpputest/cpputest.git
      revision: 42feb8740bea189667528bda8a2fd0eb745da637
```
