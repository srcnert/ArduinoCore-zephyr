## Kconfig.rak
```kconfig
# Copyright (c) 2026 RAKwireless Technology Limited
# Author: sercan.erat@rakwireless.com
# SPDX-License-Identifier: Apache-2.0

config RAK_RUI_API
	bool "RAK extensions to the Arduino API"
	depends on ARDUINO_API
	default n
	help
	  Build the RAK additions in cores/arduino/rak and make them part of the
	  Arduino core.

	  With this option disabled the core behaves like upstream
	  ArduinoCore-zephyr and none of the RAK sources are compiled.

config RAK_EXPORT_MATH
	bool "Export the math.h functions to sketches"
	default y
	help
	  Link the math.h functions into the loader and export them to
	  sketches, like upstream ArduinoCore-zephyr.

	  With this option disabled the loader leaves them out and every
	  sketch links only the math functions it calls.

config RAK_EXPORT_LIBC_EXTRAS
	bool "Export mktime() and strerror_r() to sketches"
	default y
	help
	  Link mktime() and the XSI strerror_r() used by std::error_code into
	  the loader and export them to sketches, like upstream
	  ArduinoCore-zephyr.

	  With this option disabled the loader leaves them out and a sketch
	  that calls one of them links its own copy.

rsource "modules/Kconfig"
```

## modules/Kconfig
```kconfig
# Copyright (c) 2026 RAKwireless Technology Limited
# Author: sercan.erat@rakwireless.com
# SPDX-License-Identifier: Apache-2.0

menu "RAKwireless Modules"
rsource "rak_double_tap/Kconfig"
rsource "rak_regout0_fix/Kconfig"
endmenu
```

## modules/rak_cpputest/Kconfig
```kconfig
# Copyright (c) 2026 RAKwireless Technology Limited
# Author: sercan.erat@rakwireless.com
# SPDX-License-Identifier: Apache-2.0

config RAK_CPPUTEST
	bool "CppUTest unit test framework for sketches"
	depends on CPP
	depends on LLEXT
	select REQUIRES_FULL_LIBC
	select REQUIRES_FLOAT_PRINTF
	help
	  Build CppUTest from the west project in modules/lib/cpputest into
	  the loader and export it, so that a sketch can include
	  cpputest_sketch.h and contain only its TEST() cases.
```

## modules/rak_double_tap/Kconfig
```kconfig
# Copyright (c) 2026 RAKwireless Technology Limited
# Author: sercan.erat@rakwireless.com
# SPDX-License-Identifier: Apache-2.0

menuconfig RAK_DOUBLE_TAP
	bool "Enter the bootloader on a double tap reset"
	depends on BOARD_RAK4631_NRF52840
	depends on RETENTION_BOOT_MODE
	select HWINFO
	help
	  Pressing the reset button twice within RAK_DOUBLE_TAP_WINDOW_MS duration
	  to set the boot-mode to BOOT_MODE_TYPE_BOOTLOADER through the retention
	  area chosen as zephyr,boot-mode.

if RAK_DOUBLE_TAP

config RAK_DOUBLE_TAP_WINDOW_MS
	int "Double-tap window in milliseconds"
	default 500
	range 50 5000
	help
	  Time after a press of the reset button during which a second press
	  enters the bootloader. The bootloader busy-waits for this long after
	  every such press, so it adds directly to that boot's time.

endif # RAK_DOUBLE_TAP
```

## modules/rak_regout0_fix/Kconfig
```kconfig
# Copyright (c) 2026 RAKwireless Technology Limited
# Author: sercan.erat@rakwireless.com
# SPDX-License-Identifier: Apache-2.0

config RAK_REGOUT0_FIX
	bool "Program UICR REGOUT0 to 3.3 V on a VDDH-powered RAK4630"
	depends on BOARD_RAK4631_NRF52840
	help
	  Early-boot hook for the RAK4630 module, whose nRF52840 is supplied
	  through VDDH. A full chip erase leaves UICR REGOUT0 at its 1.8 V
	  default, which underpowers the LEDs and 3.3 V peripherals. The hook
	  programs REGOUT0 to 3.3 V once and resets the chip. It is a no-op
	  when the chip runs in normal-voltage mode or REGOUT0 is already set.
```

## samples/hello_arduino/boards/nrf52840dk_nrf52840.conf
```kconfig
# Copyright (c) 2026 RAKwireless Technology Limited
# Author: sercan.erat@rakwireless.com
# SPDX-License-Identifier: Apache-2.0

CONFIG_SYSTEM_WORKQUEUE_STACK_SIZE=2048

CONFIG_USB_DEVICE_STACK_NEXT=y
CONFIG_USB_DEVICE_PRODUCT="RAKwireless RAK4631"
CONFIG_USB_DEVICE_MANUFACTURER="RAKwireless"
# Use Nordic's VID and PID
CONFIG_USB_DEVICE_VID=0x1915
CONFIG_USB_DEVICE_PID=0x5300
CONFIG_USB_CONFIGURATION_STRING_DESC_ENABLE=n

CONFIG_USBD_CDC_ACM_CLASS=y
CONFIG_CDC_ACM_SERIAL_INITIALIZE_AT_BOOT=n
CONFIG_USBD_CDC_ACM_BUF_POOL=y
CONFIG_UART_LINE_CTRL=y
# CONFIG_USBD_CDC_ACM_LOG_LEVEL_ERR=y
# CONFIG_UDC_DRIVER_LOG_LEVEL_ERR=y
# CONFIG_USBD_LOG_LEVEL_ERR=y

CONFIG_GPIO=y
CONFIG_I2C=y
CONFIG_SPI=y
CONFIG_ADC=y
CONFIG_PWM=y
CONFIG_COUNTER=y

CONFIG_FPU=y

CONFIG_LOG=n
```

## test/coverage/testcase.yaml
```yaml
# Copyright (c) 2026 RAKwireless Technology Limited
# Author: sercan.erat@rakwireless.com
# SPDX-License-Identifier: Apache-2.0

tests:
  rak.coverage:
    platform_allow: mps2/an386
```

## test/unit/arduino_official_common/testcase.yaml
```yaml
# Copyright (c) 2026 RAKwireless Technology Limited
# Author: sercan.erat@rakwireless.com
# SPDX-License-Identifier: Apache-2.0

tests:
  rak.arduino_official_common: {}
```
